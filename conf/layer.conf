## conf/layer.conf
```bitbake
# We have a conf and classes directory, add to BBPATH
BBPATH .= ":${LAYERDIR}"

# We have recipes-* directories, add to BBFILES
BBFILES += "${LAYERDIR}/recipes-*/*/*.bb \
            ${LAYERDIR}/recipes-*/*/*.bbappend"

BBFILE_COLLECTIONS += "meta-beacon-common"
BBFILE_PATTERN_meta-beacon-common := "^${LAYERDIR}/"
BBFILE_PRIORITY_meta-beacon-common := "5"

LAYERSERIES_COMPAT_meta-beacon-common = "styhead"

PREFERRED_VERSION_libcamera = "0.4.0"

# Keep this list alphabetized
IMAGE_INSTALL:append = " \
	beacon-eeprom-decoder \
	beacon-eeprom-services \
	bluez5 \
	bridge-utils \
	cpufrequtils \
	devmem2 \
	dhrystone \
	edid-decode \
	ethtool \
	evtest \
	faac \
	flashrom \
	i2c-tools \
	iperf3 \
	glmark2 \
	gstreamer1.0-libav \
	libcamera \
	libcamera-gst \
	libgpiod \
	libgpiod-tools \
	libntfs-3g \
	linpack \
	lshw \
	memtester \
	ntfs-3g \
	ntfsprogs \
	pipewire \
	pointercal \
	rng-tools \
	spitools \
	tzdata \
	tslib \
	tslib-conf \
	tslib-tests \
	tslib-calibrate \
	u-boot-fw-utils \
	whetstone \ 
	yavta \
"
```
